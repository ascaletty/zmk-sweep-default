## config/west.yml
```yaml
manifest:
  remotes:
    - name: ascaletty
      url-base: https://github.com/ascaletty
  projects:
    - name: myzmk
      remote: ascaletty
      revision: main
      import: app/west.yml
  self:
    path: config
```
